## configs/scai_navc_defconfig
```kconfig
CONFIG_RISCV=y
CONFIG_SYS_MALLOC_LEN=0x800000
CONFIG_SYS_MALLOC_F_LEN=0x2000
CONFIG_HAS_CUSTOM_SYS_INIT_SP_ADDR=y
CONFIG_CUSTOM_SYS_INIT_SP_ADDR=0x80200000
CONFIG_ENV_SIZE=0x2000
CONFIG_DEFAULT_DEVICE_TREE="scai-navc"
CONFIG_SYS_PROMPT="SCAI-NAVC # "
CONFIG_OF_LIBFDT_OVERLAY=y
CONFIG_SYS_LOAD_ADDR=0x80200000
CONFIG_TARGET_SCAI_NAVC=y
CONFIG_ARCH_RV64I=y
CONFIG_RISCV_SMODE=y
CONFIG_FIT=y
CONFIG_OF_BOARD_SETUP=y
CONFIG_DISTRO_DEFAULTS=y
CONFIG_DISPLAY_CPUINFO=y
CONFIG_DISPLAY_BOARDINFO=y
CONFIG_SYS_CBSIZE=256
CONFIG_SYS_PBSIZE=282
CONFIG_SYS_BOOTM_LEN=0x4000000
CONFIG_MTDPARTS_DEFAULT="mtdparts=spi-nand0:2m(payload),119m(ubi)"
CONFIG_CMD_UBI=y
CONFIG_OVERWRITE_ETHADDR_ONCE=y
CONFIG_SYS_RELOC_GD_ENV_ADDR=y
CONFIG_BOOTP_SEND_HOSTNAME=y
CONFIG_DM_MAILBOX=y
CONFIG_MPFS_MBOX=y
CONFIG_MISC=y
CONFIG_MPFS_SYSCONTROLLER=y
CONFIG_DM_MTD=y
CONFIG_SYSRESET=y
CONFIG_NAND=y
CONFIG_DM_NAND=y
CONFIG_MTD_SCAI_MT29F=y
CONFIG_MTD_SPI_NAND=y
CONFIG_MTD_NAND_CORE=y
# CONFIG_SPI_FLASH_WINBOND=y
```

## drivers/mtd/nand/Kconfig
```kconfig
source "drivers/mtd/nand/scai_mt29f/Kconfig"

config MTD_NAND_CORE
	tristate

source "drivers/mtd/nand/raw/Kconfig"

source "drivers/mtd/nand/spi/Kconfig"
```

## drivers/mtd/nand/scai_mt29f/Kconfig
```kconfig
config MTD_SCAI_MT29F
	bool "SCAI Micron MT29F flash memory support"
	default y
	help
	  This enables support for a custom SCAI Micron MT29F flash memory controller.
```
